
// ****************************************************************************
//                                 
//                              Main code
//
// ****************************************************************************

#include "../include.h"

#define LCD_COLS	16	// number of characters per row
#define LCD_ROWS	2	// number of rows

cLCDTXT	LCDTxt;

// remap characters 0x20-0x3F
const char Remap1[32] = {
	0x20, 0x21, 0x22, 0x23, 0x24, 0x25, 0x26, 0x27,
	0x28, 0x29, 0x2A, 0x2B, 0x2C, 0x2D, 0x2E, 0x2F,
	0x30, 0x31, 0x32, 0x33, 0x34, 0x35, 0x36, 0x37,
	0x38, 0x39, 0x3A, 0x3B, 0x3C, 0x3D, 0x3E, 0x3F,
};

// remap characters 0x40-0x5F
const char Remap2[32] = {
	0x40, 0x41, 0x42, 0x43, 0x44, 0x45, 0x46, 0x47,
	0x48, 0x49, 0x4A, 0x4B, 0x4C, 0x4D, 0x4E, 0x4F,
	0x50, 0x51, 0x52, 0x53, 0x54, 0x55, 0x56, 0x57,
	0x58, 0x59, 0x5A, 0x5B, 0x5C, 0x5D, 0x5E, 0x5F,
};

// remap characters 0x60-0x7F
const char Remap3[32] = {
	0x60, 0x61, 0x62, 0x63, 0x64, 0x65, 0x66, 0x67,
	0x68, 0x69, 0x6A, 0x6B, 0x6C, 0x6D, 0x6E, 0x6F,
	0x70, 0x71, 0x72, 0x73, 0x74, 0x75, 0x76, 0x77,
	0x78, 0x79, 0x7A, 0x7B, 0x7C, 0x7D, 0x7E, 0x7F,
};

// remap characters 0x00-0x1F, default font
const char Remap4[32] = {
	0x00, 0x5C, 0x7E, 0x01, 0x02, 0x7F, 0x03, 0x08,
	0x00, 0x5C, 0x7E, 0x01, 0x02, 0x7F, 0x03, 0x08,
	0x20, 0x20, 0x20, 0x20, 0x20, 0x20, 0x20, 0x20,
	0x20, 0x20, 0x20, 0x20, 0x20, 0x20, 0x20, 0x20,
};

// remap characters 0x00-0x1F, left-bar font
const char Remap5[32] = {
	0x04, 0x05, 0x06, 0x07, 0x08, 0x0D, 0x0E, 0x10,
	0x04, 0x05, 0x06, 0x07, 0x08, 0x0D, 0x0E, 0x10,
	0x20, 0x20, 0x20, 0x20, 0x20, 0x20, 0x20, 0x20,
	0x20, 0x20, 0x20, 0x20, 0x20, 0x20, 0x20, 0x20,
};

// remap characters 0x00-0x1F, right-bar font
const char Remap6[32] = {
	0x0C, 0x0B, 0x0A, 0x09, 0x08, 0x0D, 0x0F, 0x11,
	0x0C, 0x0B, 0x0A, 0x09, 0x08, 0x0D, 0x0F, 0x11,
	0x20, 0x20, 0x20, 0x20, 0x20, 0x20, 0x20, 0x20,
	0x20, 0x20, 0x20, 0x20, 0x20, 0x20, 0x20, 0x20,
};

// remap characters 0x00-0x1F, line font
const char Remap7[32] = {
	0x12, 0x13, 0x14, 0x15, 0x16, 0x17, 0x18, 0x08,
	0x12, 0x13, 0x14, 0x15, 0x16, 0x17, 0x18, 0x08,
	0x20, 0x20, 0x20, 0x20, 0x20, 0x20, 0x20, 0x20,
	0x20, 0x20, 0x20, 0x20, 0x20, 0x20, 0x20, 0x20,
};

// remap characters 0x00-0x1F, pixel font
const char Remap8[32] = {
	0x19, 0x1A, 0x1B, 0x1C, 0x1D, 0x16, 0x08, 0x0D,
	0x19, 0x1A, 0x1B, 0x1C, 0x1D, 0x16, 0x08, 0x0D,
	0x20, 0x20, 0x20, 0x20, 0x20, 0x20, 0x20, 0x20,
	0x20, 0x20, 0x20, 0x20, 0x20, 0x20, 0x20, 0x20,
};

// remap characters 0x00-0x1F, user font
const char Remap9[32] = {
	0x41, 0x42, 0x43, 0x44, 0x45, 0x46, 0x47, 0x48,
	0x41, 0x42, 0x43, 0x44, 0x45, 0x46, 0x47, 0x48,
	0x20, 0x20, 0x20, 0x20, 0x20, 0x20, 0x20, 0x20,
	0x20, 0x20, 0x20, 0x20, 0x20, 0x20, 0x20, 0x20,
};

// draw display
#define XX 64
#define YY 120
#define DX 12
#define DY 18

// print characters
void LCDPrint(const char* t)
{
	SelFont5x7Lcd();
	int i;
	for (i = 0; i < 16; i++) DrawChar2((u8)*t++, XX+i*DX, YY, COLOR(10, 20, 0));
	for (i = 0; i < 16; i++) DrawChar2((u8)*t++, XX+i*DX, YY+DY, COLOR(10, 20, 0));
}

int main()
{
	int i, j, cols, rows;
	int test = 1;

	// initialize
	Bool res = LCDTxt.Init(0, 0);
	cols = LCDTxt.cols;
	rows = LCDTxt.rows;
	LCDTxt.cols = LCD_COLS;
	LCDTxt.rows = LCD_ROWS;
	DispUpdate();

	while (True)
	{
Restart:
		// clear screen
		DrawClear();

		// base info
		SelFont8x16();
		printf(res ? "LCD16x2 initialized OK\n" : "LCD16x2 not found\n");
		printf("Rows=%d, Columns=%d\n", rows, cols);
		printf("Left/Right: select test\n");
		printf("\n");

		// draw display background
// 1 character is 5x8, with space 6x8, we will use doube-size, 16 characters x 2 rows = 192 x 32 pixels
		DrawRect(XX-14, YY-4, 220, 40, COLOR(80, 120, 10));
		for (i = 0; i < 16; i++) DrawRect(XX+i*DX, YY, 10, 16, COLOR(50, 90, 8));
		for (i = 0; i < 16; i++) DrawRect(XX+i*DX, YY+DY, 10, 16, COLOR(50, 90, 8));

		// tests
		switch (test)
		{
		// test 1: characters 0x20..0x3F
		case 1:
			printf("Test 1: characters 0x20..0x3F\n");
			for (i = 0; i < 0+LCD_COLS*LCD_ROWS; i++) LCDTxt.buf[i] = i+0x20;
			LCDPrint(Remap1);
			LCDTxt.SelFont(LCDTXT_FONT_DEF);
			break;

		// test 2: characters 0x40..0x5F
		case 2:
			printf("Test 2: characters 0x40..0x5F\n");
			for (i = 0; i < 0+LCD_COLS*LCD_ROWS; i++) LCDTxt.buf[i] = i+0x40;
			LCDPrint(Remap2);
			LCDTxt.SelFont(LCDTXT_FONT_DEF);
			break;

		// test 3: characters 0x60..0x7F
		case 3:
			printf("Test 3: characters 0x60..0x7F\n");
			for (i = 0; i < 0+LCD_COLS*LCD_ROWS; i++) LCDTxt.buf[i] = i+0x60;
			LCDPrint(Remap3);
			LCDTxt.SelFont(LCDTXT_FONT_DEF);
			break;

		// test 4: characters 0x00-0x1F, default font
		case 4:
			printf("Test 4: default font 0x00..0x1F\n");
			for (i = 0; i < 0+LCD_COLS*LCD_ROWS; i++) LCDTxt.buf[i] = i;
			LCDPrint(Remap4);
			LCDTxt.SelFont(LCDTXT_FONT_DEF);
			break;

		// test 5: characters 0x00-0x1F, left-bar font
		case 5:
			printf("Test 5: left-bar font 0x00..0x1F\n");
			for (i = 0; i < 0+LCD_COLS*LCD_ROWS; i++) LCDTxt.buf[i] = i;
			LCDPrint(Remap5);
			LCDTxt.SelFont(LCDTXT_FONT_COLL);
			break;

		// test 6: characters 0x00-0x1F, right-bar font
		case 6:
			printf("Test 6: right-bar font 0x00..0x1F\n");
			for (i = 0; i < 0+LCD_COLS*LCD_ROWS; i++) LCDTxt.buf[i] = i;
			LCDPrint(Remap6);
			LCDTxt.SelFont(LCDTXT_FONT_COLR);
			break;

		// test 7: characters 0x00-0x1F, line font
		case 7:
			printf("Test 7: line font 0x00..0x1F\n");
			for (i = 0; i < 0+LCD_COLS*LCD_ROWS; i++) LCDTxt.buf[i] = i;
			LCDPrint(Remap7);
			LCDTxt.SelFont(LCDTXT_FONT_LINE);
			break;

		// test 8: characters 0x00-0x1F, pixel font
		case 8:
			printf("Test 8: pixel font 0x00..0x1F\n");
			for (i = 0; i < 0+LCD_COLS*LCD_ROWS; i++) LCDTxt.buf[i] = i;
			LCDPrint(Remap8);
			LCDTxt.SelFont(LCDTXT_FONT_PIX);
			break;

		// test 9: characters 0x00-0x1F, user font
		case 9:
			printf("Test 9: user font 0x00..0x1F\n");

			// update user fonts
			for (i = 0; i < 8; i++)
			{
				for (j = 0; j < 8; j++)
				{
					LCDTxt.buf[i*8+j] = (~FontLcd5x7['A'+i+j*128]) >> 3;
				}
			}
			LCDTxt.UserFont((const u8*)LCDTxt.buf);
			LCDTxt.SelFont(LCDTXT_FONT_USER);

			for (i = 0; i < 0+LCD_COLS*LCD_ROWS; i++) LCDTxt.buf[i] = i;
			LCDPrint(Remap9);
			break;
		}
		LCDTxt.Update();
		DispUpdate();

		// keyboard
		while (True)
		{
			u8 key = KeyGet();
			if (key == KEY_PAD_Y) Reboot();	// Program exit
			if (key == KEY_SCREENSHOT) ScreenShot(); //  Screenshot - This may take a few seconds to write.
			if ((key == KEY_LEFT) && (test > 1))
			{
				test--;
				goto Restart;
			}
			if ((key == KEY_RIGHT) && (test < 9))
			{
				test++;
				goto Restart;
			}
		}
	}
}
